## br2_external/Config.in
```kconfig
menu "Custom packages"

source "$BR2_EXTERNAL_RPI5_PATH/package/kiosk-player/Config.in"

endmenu
```

## br2_external/package/kiosk-player/Config.in
```kconfig
config BR2_PACKAGE_KIOSK_PLAYER
    bool "kiosk player (mpv fullscreen)"
    select BR2_PACKAGE_MPV
    select BR2_PACKAGE_WESTON
    help
      Automatic fullscreen video kiosk using mpv.
```
